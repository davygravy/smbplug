## package/libieee1284/Config.in
```kconfig
config BR2_PACKAGE_LIBIEEE1284
	bool "libieee1284"
	help
	  libieee1284 is intended to be used by applications 
          that need to communicate with (or at least identify) 
          devices that are attached via a parallel port. 

	  http://sourceforge.net/projects/libieee1284/
```

## package/libinklevel/Config.in
```kconfig
config BR2_PACKAGE_LIBINKLEVEL
	bool "libinklevel"
	help
	  libinklevel is is a library that communicates 
          with USB and parallel port printers to check
          and report their ink levels.

	  http://sourceforge.net/projects/libinklevel/
```
